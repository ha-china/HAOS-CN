## buildroot-external/configs/orangepi-4-lts_defconfig
```kconfig
BR2_aarch64=y
BR2_cortex_a72_a53=y
BR2_DL_DIR="/cache/dl"
BR2_CCACHE=y
BR2_CCACHE_DIR="/cache/cc"
BR2_OPTIMIZE_2=y
BR2_GLOBAL_PATCH_DIR="$(BR2_EXTERNAL_HASSOS_PATH)/patches $(BR2_EXTERNAL_HASSOS_PATH)/board/orangepi/orangepi-4-lts/patches"
# BR2_TARGET_GENERIC_REMOUNT_ROOTFS_RW is not set
BR2_GCC_ENABLE_LTO=y
BR2_GCC_VERSION_11_X=y
BR2_INIT_SYSTEMD=y
BR2_ROOTFS_OVERLAY="$(BR2_EXTERNAL_HASSOS_PATH)/board/orangepi/orangepi-4-lts/rootfs-overlay"
BR2_ROOTFS_POST_BUILD_SCRIPT="$(BR2_EXTERNAL_HASSOS_PATH)/scripts/post-build.sh"
BR2_ROOTFS_POST_IMAGE_SCRIPT="$(BR2_EXTERNAL_HASSOS_PATH)/scripts/post-image.sh"
BR2_ROOTFS_POST_SCRIPT_ARGS="$(BR2_EXTERNAL_HASSOS_PATH)/board/orangepi/orangepi-4-lts $(BR2_EXTERNAL_HASSOS_PATH)/board/orangepi/orangepi-4-lts/hassos-hook.sh"
BR2_SSP_REGULAR=y
BR2_TARGET_GENERIC_HOSTNAME="homeassistant"
BR2_TARGET_GENERIC_ISSUE="Welcome to Home Assistant"
BR2_TARGET_ROOTFS_SQUASHFS=y
BR2_TARGET_ROOTFS_SQUASHFS4_LZ4=y
# BR2_TARGET_ROOTFS_TAR is not set
BR2_TOOLCHAIN_BUILDROOT_CXX=y
BR2_TOOLCHAIN_BUILDROOT_GLIBC=y

# Firmware
BR2_TARGET_ARM_TRUSTED_FIRMWARE=y
BR2_TARGET_ARM_TRUSTED_FIRMWARE_CUSTOM_GIT=y
BR2_TARGET_ARM_TRUSTED_FIRMWARE_CUSTOM_REPO_URL="https://git.trustedfirmware.org/TF-A/trusted-firmware-a.git"
BR2_TARGET_ARM_TRUSTED_FIRMWARE_CUSTOM_REPO_VERSION="9881bb93a3bc0a3ea37e9f093e09ab4b360a9e48"
BR2_TARGET_ARM_TRUSTED_FIRMWARE_PLATFORM="rk3399"
BR2_TARGET_ARM_TRUSTED_FIRMWARE_BL31=y
BR2_TARGET_ARM_TRUSTED_FIRMWARE_NEEDS_ARM32_TOOLCHAIN=y
BR2_TARGET_ARM_TRUSTED_FIRMWARE_IMAGES=""

# Bootloader
BR2_TARGET_UBOOT=y
BR2_TARGET_UBOOT_BUILD_SYSTEM_KCONFIG=y
BR2_TARGET_UBOOT_CUSTOM_VERSION=y
BR2_TARGET_UBOOT_CUSTOM_VERSION_VALUE="2023.01"
BR2_TARGET_UBOOT_BOARD_DEFCONFIG="orangepi_4_lts_rk3399"
BR2_TARGET_UBOOT_CONFIG_FRAGMENT_FILES="$(BR2_EXTERNAL_HASSOS_PATH)/bootloader/uboot.config $(BR2_EXTERNAL_HASSOS_PATH)/board/orangepi/orangepi-4-lts/uboot.config"
BR2_TARGET_UBOOT_NEEDS_DTC=y
BR2_TARGET_UBOOT_NEEDS_PYTHON3=y
BR2_TARGET_UBOOT_NEEDS_ATF_BL31=y
BR2_TARGET_UBOOT_NEEDS_ATF_BL31_ELF=y
BR2_TARGET_UBOOT_FORMAT_CUSTOM=y
BR2_TARGET_UBOOT_FORMAT_CUSTOM_NAME="u-boot.itb"
BR2_TARGET_UBOOT_SPL=y
BR2_TARGET_UBOOT_SPL_NAME="idbloader.img"

# Kernel
BR2_LINUX_KERNEL=y
BR2_LINUX_KERNEL_CUSTOM_VERSION=y
BR2_LINUX_KERNEL_CUSTOM_VERSION_VALUE="6.12.33"
BR2_LINUX_KERNEL_USE_ARCH_DEFAULT_CONFIG=y
BR2_LINUX_KERNEL_CONFIG_FRAGMENT_FILES="$(BR2_EXTERNAL_HASSOS_PATH)/kernel/hassos.config $(BR2_EXTERNAL_HASSOS_PATH)/kernel/docker.config $(BR2_EXTERNAL_HASSOS_PATH)/kernel/device-support.config $(BR2_EXTERNAL_HASSOS_PATH)/board/orangepi/orangepi-4-lts/kernel.config"
BR2_LINUX_KERNEL_LZ4=y
BR2_LINUX_KERNEL_DTS_SUPPORT=y
BR2_LINUX_KERNEL_INTREE_DTS_NAME="rockchip/rk3399-orangepi-4-lts"
BR2_LINUX_KERNEL_DTB_OVERLAY_SUPPORT=y
BR2_LINUX_KERNEL_NEEDS_HOST_OPENSSL=y
BR2_LINUX_KERNEL_NEEDS_HOST_LIBELF=y

# Host Packages
BR2_PACKAGE_ROCKCHIP_BLOBS=y
BR2_PACKAGE_ROCKCHIP_BLOBS_VERSION="b2dec11618b644d7fc8ac0eb7694a245667f5981"
BR2_PACKAGE_ROCKCHIP_BLOBS_ATF="bin/rk33/rk3399_bl31_v1.35.elf"
BR2_PACKAGE_ROCKCHIP_BLOBS_TPL="bin/rk33/rk3399_ddr_933MHz_v1.26.bin"
BR2_PACKAGE_HOST_LINUX_HEADERS_CUSTOM_6_1=y
BR2_PACKAGE_HOST_DOSFSTOOLS=y
BR2_PACKAGE_HOST_E2FSPROGS=y
BR2_PACKAGE_HOST_GPTFDISK=y
BR2_PACKAGE_HOST_MTOOLS=y
BR2_PACKAGE_HOST_RAUC=y
BR2_PACKAGE_HOST_TEMPIO=y
BR2_PACKAGE_HOST_UBOOT_TOOLS=y
BR2_PACKAGE_HOST_UBOOT_TOOLS_BOOT_SCRIPT=y
BR2_PACKAGE_HOST_UBOOT_TOOLS_BOOT_SCRIPT_SOURCE="$(BR2_EXTERNAL_HASSOS_PATH)/board/orangepi/orangepi-4-lts/uboot-boot.ush"
BR2_PACKAGE_HOST_SWIG=y  # required by uboot 2023.01

# Packages
BR2_PACKAGE_APPARMOR=y
BR2_PACKAGE_APPARMOR_PROFILES=y
BR2_PACKAGE_BLUEZ5_UTILS=y
BR2_PACKAGE_BLUEZ5_UTILS_CLIENT=y
BR2_PACKAGE_BLUEZ5_UTILS_PLUGINS_AUDIO=y
BR2_PACKAGE_BLUEZ5_UTILS_PLUGINS_HID=y
BR2_PACKAGE_BLUEZ5_UTILS_PLUGINS_HOG=y
BR2_PACKAGE_BLUEZ5_UTILS_TOOLS=y
BR2_PACKAGE_BRCMFMAC_SDIO_FIRMWARE_RPI=y
BR2_PACKAGE_BRCMFMAC_SDIO_FIRMWARE_RPI_BT=y
BR2_PACKAGE_BRCMFMAC_SDIO_FIRMWARE_RPI_WIFI=y
BR2_PACKAGE_BUSYBOX_CONFIG="$(BR2_EXTERNAL_HASSOS_PATH)/busybox.config"
BR2_PACKAGE_BUSYBOX_INDIVIDUAL_BINARIES=y
BR2_PACKAGE_CA_CERTIFICATES=y
BR2_PACKAGE_DBUS_BROKER=y
BR2_PACKAGE_DHCP_CLIENT=y
BR2_PACKAGE_DHCP=y
BR2_PACKAGE_DOCKER_CLI=y
BR2_PACKAGE_DOCKER_ENGINE=y
BR2_PACKAGE_DOSFSTOOLS=y
BR2_PACKAGE_DOSFSTOOLS_FSCK_FAT=y
BR2_PACKAGE_DROPBEAR=y
BR2_PACKAGE_E2FSPROGS=y
BR2_PACKAGE_E2FSPROGS_E2IMAGE=y
BR2_PACKAGE_GPTFDISK=y
BR2_PACKAGE_GPTFDISK_SGDISK=y
BR2_PACKAGE_HASSIO=y
BR2_PACKAGE_HASSIO_ARCH="aarch64"
BR2_PACKAGE_HASSIO_MACHINE="qemuarm-64"  # use the generic aarch64 image
# BR2_PACKAGE_IFUPDOWN_SCRIPTS is not set
BR2_PACKAGE_IPTABLES_NFTABLES_DEFAULT=y
BR2_PACKAGE_IPTABLES_NFTABLES=y
BR2_PACKAGE_JQ=y
BR2_PACKAGE_LESS=y
BR2_PACKAGE_LIBCGROUP=y
BR2_PACKAGE_LIBCGROUP_TOOLS=y
BR2_PACKAGE_LIBCURL_CURL=y
BR2_PACKAGE_LIBDNET=y
# BR2_PACKAGE_LVM2_STANDARD_INSTALL is not set
BR2_PACKAGE_NETWORK_MANAGER=y
BR2_PACKAGE_NVME=y
BR2_PACKAGE_OS_AGENT=y
BR2_PACKAGE_OS_AGENT_BOARD="OrangePi4LTS"
BR2_PACKAGE_PROCPS_NG=y
BR2_PACKAGE_RAUC=y
BR2_PACKAGE_RAUC_DBUS=y
BR2_PACKAGE_RAUC_NETWORK=y
BR2_PACKAGE_RNG_TOOLS=y
BR2_PACKAGE_SYSTEMD_COREDUMP=y
# BR2_PACKAGE_SYSTEMD_HWDB is not set
BR2_PACKAGE_SYSTEMD_JOURNAL_REMOTE=y
BR2_PACKAGE_SYSTEMD_LOGIND=y
# BR2_PACKAGE_SYSTEMD_NETWORKD is not set
BR2_PACKAGE_SYSTEMD_RANDOMSEED=y
BR2_PACKAGE_TINI=y
BR2_PACKAGE_UDISKS2=y
BR2_PACKAGE_USB_MODESWITCH_DATA=y
BR2_PACKAGE_UTIL_LINUX_LOGIN=y
BR2_PACKAGE_UTIL_LINUX_NOLOGIN=y
BR2_PACKAGE_UTIL_LINUX_PARTX=y
BR2_PACKAGE_UTIL_LINUX_SULOGIN=y
BR2_PACKAGE_UTIL_LINUX_ZRAMCTL=y
BR2_PACKAGE_UTIL_LINUX_RFKILL=y
BR2_PACKAGE_WIRELESS_REGDB=y
BR2_PACKAGE_WPA_SUPPLICANT=y
BR2_PACKAGE_WPA_SUPPLICANT_DBUS=y
BR2_PACKAGE_WPA_SUPPLICANT_DBUS_INTROSPECTION=y
BR2_PACKAGE_WPA_SUPPLICANT_WEXT=y
BR2_PACKAGE_WPA_SUPPLICANT_NL80211=y
BR2_PACKAGE_WPA_SUPPLICANT_AP_SUPPORT=y
BR2_PACKAGE_V4L2LOOPBACK=y
```

## buildroot-external/package/ap6236_firmware/Config.in
```kconfig
config BR2_PACKAGE_AP6236_FIRMWARE
	bool "Firmware for AMPAK AP6236"
	help
	  At least some AP6236 seem to be BCM43436B0, not BCM43430.
	  Use this firmware package for those
```

## buildroot-external/package/ap6256_firmware/Config.in
```kconfig
config BR2_PACKAGE_AP6256_FIRMWARE
    bool "Broadcom BCM43456 Wi-Fi & Bluetooth firmware"
    help
      Custom firmware files for BCM43456 on RK3566 (Orange Pi CM4).
```

## buildroot-external/package/matter/Config.in
```kconfig
config BR2_PACKAGE_MATTER
    bool "matter support"
    help
      matter support
```

## buildroot-external/package/rknpu-driver/Config.in
```kconfig
config BR2_PACKAGE_RKNPU_DRIVER
	bool "rknpu-driver"
	depends on BR2_LINUX_KERNEL
	depends on BR2_aarch64
	help
	  RKNPU (Rockchip Neural Processing Unit) kernel driver
	  for RK3588 series SoCs.
	  
	  This driver provides kernel-level support for Rockchip's
	  NPU hardware acceleration, enabling AI inference capabilities
	  on RK3588 platforms.
	  
	  Supports:
	  - RK3588 series (including RK3588S)
	  - Hardware AI acceleration
	  - RKNN model inference
	  - Memory management for NPU
	  
	  Note: This is the out-of-tree driver from Rockchip.
	  Main kernel Panfrost driver does not include NPU support.
	  
	  https://github.com/airockchip/rknn-llm

comment "rknpu-driver needs a Linux kernel to be built"
	depends on !BR2_LINUX_KERNEL

comment "rknpu-driver is only available on aarch64"
	depends on !BR2_aarch64
```

## buildroot-external/package/rockchip-blobs/Config.in
```kconfig
config BR2_PACKAGE_ROCKCHIP_BLOBS
	bool "rockchip-blobs"
	depends on BR2_aarch64
	depends on BR2_TARGET_UBOOT
	help
	  Rockchip proprietary firmware binaries for RK35xx series SoCs.
	  
	  This package provides essential bootloader blobs required for
	  Rockchip RK3588 series SoCs, including:
	  - ARM Trusted Firmware (ATF/BL31)
	  - DDR initialization firmware (TPL)
	  - Trust Execution Environment (TEE) firmware
	  
	  These blobs are required for proper boot sequence on RK3588
	  platforms like ROCK 5B, Orange Pi 5B, etc.
	  
	  The package downloads official Rockchip firmware from their
	  GitHub repository and configures U-Boot to use the appropriate
	  binaries based on the target platform.
	  
	  https://github.com/rockchip-linux/rkbin

comment "rockchip-blobs needs ARM64 architecture"
	depends on !BR2_aarch64

comment "rockchip-blobs needs U-Boot to be built"
	depends on !BR2_TARGET_UBOOT
```
